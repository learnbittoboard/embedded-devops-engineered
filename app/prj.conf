## CMakeLists.txt
```
# Chapter 9, Step 3 — The good v2: same 1.1.0 as Step 2, plus the one
# missing line — the image confirms itself once it has proven it works.
cmake_minimum_required(VERSION 3.20.0)
find_package(Zephyr REQUIRED HINTS $ENV{ZEPHYR_BASE})
project(ch10_ota_package)

target_sources(app PRIVATE src/main.c src/ld2410.c src/ld2410_parser.c)
target_include_directories(app PRIVATE include)
```

## Kconfig
```
# Chapters 7–8 sensor apps — the application Kconfig.
#
# Two jobs: this product's first real knob (below), and the
# LD2410 log template at the bottom. Per-module log-level symbols
# for our driver exist only where a Kconfig file instantiates
# Zephyr's log-config template for that module name (Chapter 2,
# Step 3) — that is what lets prj.conf aim the driver's log
# level without touching the driver.

menu "Occupancy product behaviour"

config OCCUPANCY_OFF_DELAY_SEC
	int "Seconds of continuous no-presence before the bulb is switched off"
	default 30
	range 0 3600
	help
	  The occupied-to-unoccupied hold time of the product: when
	  the room empties, the bulb stays on for this long before
	  the Off command is sent. Semantically this is the ZCL
	  Occupancy Sensing cluster's UltrasonicOccupiedToUnoccupied-
	  Delay attribute (0x0020); ZBOSS's standard attribute list
	  for the cluster does not declare the delay attributes, so
	  the product implements the same policy in its glue —
	  configurable here, settable per build in prj.conf:
	      CONFIG_OCCUPANCY_OFF_DELAY_SEC=120
	  Zero means "off the moment the room reads empty" — legal,
	  and a fine way to learn why the delay exists.

endmenu

module = LD2410
module-str = HLK-LD2410 driver (Chapters 4 + 7)
source "subsys/logging/Kconfig.template.log_config"

source "Kconfig.zephyr"
```

## sysbuild.conf
```
#
# Copyright (c) 2026 Nordic Semiconductor ASA
#
# SPDX-License-Identifier: LicenseRef-Nordic-5-Clause
#

# Disable partition manager — the flash layout comes from
# devicetree (nrf52840_partitions.dtsi + the ext-flash FOTA
# layout), exactly as in Chapters 5–8.
SB_CONFIG_PARTITION_MANAGER=n

# Chapter 9's whole subject: add MCUboot as the bootloader
# image. Sysbuild builds it as a second image, places this app
# in slot 0, and signs the app image (the build proves it: a
# zephyr.signed.bin appears next to zephyr.bin, and NCS packs
# a dfu_application.zip). The bootloader's own configuration
# lives in sysbuild/mcuboot/.
SB_CONFIG_BOOTLOADER_MCUBOOT=y

# Chapter 10: build the DFU multi-image package. The add-on's
# sysbuild hook wraps that package (dfu_multi_image.bin) in
# the Zigbee OTA header to produce the .zigbee file — but only
# if the package build is enabled HERE, at sysbuild level.
# CONFIG_ZIGBEE_FOTA's own "imply DFU_MULTI_IMAGE_PACKAGE_BUILD"
# names an app-level symbol that does not exist; the imply
# silently does nothing, the build stays green, and the only
# evidence is the add-on's warning "No Zigbee FOTA image
# format selected" and a missing .zigbee file. (Fix F6 in the
# course build log; the nrf dfu_multi_image sample's
# sysbuild.conf is the proven pattern.)
SB_CONFIG_DFU_MULTI_IMAGE_PACKAGE_BUILD=y
SB_CONFIG_DFU_MULTI_IMAGE_PACKAGE_APP=y
```

## prj.conf
```kconfig
#
# Chapter 8, Step 2 — binding & actuation.
# Configuration is Step 1's, plus one product knob that lives in
# this app's Kconfig (see Kconfig): OCCUPANCY_OFF_DELAY_SEC, the
# no-presence hold time before the bulb is switched off. It takes
# its default (30 s) from Kconfig; a build overrides it here:
#     CONFIG_OCCUPANCY_OFF_DELAY_SEC=120
#

CONFIG_NCS_SAMPLES_DEFAULTS=y

# Serial console (the DK's USB UART) for logs.
CONFIG_UART_INTERRUPT_DRIVEN=y
CONFIG_SERIAL=y
CONFIG_GPIO=y
CONFIG_CONSOLE=y
CONFIG_UART_CONSOLE=y

CONFIG_HEAP_MEM_POOL_SIZE=2048
CONFIG_MAIN_THREAD_PRIORITY=7

# The Zigbee R23 add-on itself, the application utilities, and
# this device's role: ROUTER.
CONFIG_ZIGBEE_ADD_ON=y
CONFIG_ZIGBEE_APP_UTILS=y
CONFIG_ZIGBEE_ROLE_ROUTER=y

# Enable DK LED and Buttons library
CONFIG_DK_LIBRARY=y

# This example requires more workqueue stack
CONFIG_SYSTEM_WORKQUEUE_STACK_SIZE=2048

# --- Chapter 4's driver, riding along ------------------------------
# The LD2410 receive path: interrupt-driven UART into a ring
# buffer, parser thread behind it (src/ld2410.c, unchanged).
CONFIG_RING_BUFFER=y

# The driver's own log module stays at INF: startup and resync
# warnings only. (The symbol exists because this app's Kconfig
# instantiates the log template for the LD2410 module name.)
CONFIG_LD2410_LOG_LEVEL_INF=y

# The `presence` shell command (src/main.c): live reading, driver
# counters, and the attribute the network can read.
CONFIG_SHELL=y

# --- Chapter 9: the signed image and the cable-DFU door ------------
#
# The version the BOOTLOADER AND THE OTA WORLD see. imgtool
# stamps it into the signed image header; it is deliberately a
# separate knob from the VERSION file (which feeds the app's
# own APP_VERSION_STRING log line) — the two must agree, and
# this chapter's lesson is about what breaks when they don't.
# Chapter 10 reuses this exact value as the Zigbee OTA file
# version.
CONFIG_MCUBOOT_IMGTOOL_SIGN_VERSION="1.3.0"

# --- Chapter 10, Step 2: version policy, made explicit ---------------
#
# The OTA file version a server compares is composed from the
# imgtool stamp above (four BCD bytes: 1.3.0 -> 0x01030000).
# Policy in this course is enforced at three separate gates,
# and this build sets the one that lives on the CLIENT:
#
# The hardware-version window. The FOTA library can refuse
# images whose declared HW version falls outside
# [MIN, MAX]; the floor here is this product's hardware
# revision (52, the same value CONFIG_ZIGBEE_FOTA_HW_VERSION
# advertises), the ceiling is "no limit yet". An image built
# for older hardware is refused by the client itself, before
# a single block is stored. (The other two gates — the
# server only offering newer file versions, and MCUboot's
# signature check — are covered in this step's README.)
#
# BOTH bounds are set for a packaging reason this step's
# first build exposed: zb_add_ota_header.py writes the
# HW-version fields into the .zigbee header only as a PAIR
# (its source checks both values are present). Floor-only
# left the header's field control at 0 — the client gate was
# configured, but the package advertised nothing. With both
# set, the header grows by 4 bytes and the window travels
# with the file. (Build-log fix F7.)
CONFIG_ENABLE_ZIGBEE_FOTA_MIN_HW_VERSION=y
CONFIG_ZIGBEE_FOTA_MIN_HW_VERSION=0x34
CONFIG_ENABLE_ZIGBEE_FOTA_MAX_HW_VERSION=y
CONFIG_ZIGBEE_FOTA_MAX_HW_VERSION=0xFF

# CANARY for the over-the-air desk check: the occupancy OFF
# delay drops from 30 s to 10 s. If, after the OTA update,
# the bulb obeys 10 s instead of 30 s, the new image is not
# just booted — it is BEHAVING differently, which is the
# only update proof that matters. (Chapter 8's knob; the
# override lives here so the change is one visible line.)
CONFIG_OCCUPANCY_OFF_DELAY_SEC=10

# --- Chapter 10: the Zigbee OTA client ------------------------------
#
# The add-on's FOTA library (subsys/lib/zigbee_fota) puts an
# OTA Upgrade CLIENT cluster on its own endpoint and streams
# the image into the secondary slot through the DFU target —
# the same slot 1, the same signed bytes, the same MCUboot
# trial-and-confirm contract as Chapter 9's cable path. Only
# the transport is new.
#
# CONFIG_ZIGBEE_FOTA pulls in the bootloader chain with it
# (BOOTLOADER_MCUBOOT, MCUMGR, DFU_TARGET — verify in
# .config, never trust prj.conf).
CONFIG_ZIGBEE_FOTA=y
# The OTA endpoint must NOT be the product's endpoint 10 —
# the library's default (10) collides, so the FOTA endpoint
# moves to 5, exactly as the add-on's light_switch FOTA
# configuration does.
CONFIG_ZIGBEE_FOTA_ENDPOINT=5
# Hardware version the OTA header advertises. Nordic's
# samples use 52 for the nRF52840 family; the server matches
# on this (plus manufacturer and image type) before offering
# an image.
CONFIG_ZIGBEE_FOTA_HW_VERSION=52
# The comment lands in the .zigbee file's header — the string
# a human sees when inspecting the package.
CONFIG_ZIGBEE_FOTA_COMMENT="occupancy"
# Write the downloaded image through the MCUboot DFU target
# (slot 1), not to a file or a BLE target.
CONFIG_DFU_TARGET_MCUBOOT=y
# Emit progress events so the app can log the download
# percentage while it keeps sensing and switching.
CONFIG_ZIGBEE_FOTA_PROGRESS_EVT=y
# Deliberately NOT enabled: CONFIG_ZIGBEE_FOTA_DOWNLOAD_RESUME.
# Resume lets an interrupted download continue where it
# stopped (the add-on's samples enable it); this step keeps
# the surface minimal so the plain block flow is what you
# learn. Step 2's lesson section prices the trade-off.

# The cable update path: an mcumgr SMP server on the console
# UART (the board overlay points zephyr,uart-mcumgr at uart0).
# Steps 2–3 of this chapter push signed images through it with
# the mcumgr CLI (image upload / test / list). A shipping
# product would gate this door or compile it out — Chapter 9's
# lesson says so out loud; the lab keeps it because it is also
# the window that lets you WATCH the slot states (test,
# pending, confirmed) while rollback happens.
CONFIG_MCUMGR=y
CONFIG_MCUMGR_TRANSPORT_UART=y
CONFIG_MCUMGR_GRP_IMG=y
CONFIG_MCUMGR_GRP_OS=y
# mcumgr's own dependencies are NOT selected by anything in the
# Zigbee configuration — assign them or Kconfig silently drops
# the whole subsystem (it did exactly that on this step's first
# build; the warning is in the log and the absence is in the
# built .config — check .config, not prj.conf, Chapter 2's
# rule). NET_BUF + ZCBOR are mcumgr's deps; BASE64 + CRC +
# UART_MCUMGR are the UART transport's.
CONFIG_NET_BUF=y
CONFIG_ZCBOR=y
CONFIG_BASE64=y
CONFIG_CRC=y
CONFIG_UART_MCUMGR=y

# The image manager is how mcumgr writes the secondary slot —
# which lives in the DK's external QSPI flash, so the app
# needs the QSPI NOR driver too (the bootloader has its own
# copy, configured under sysbuild/mcuboot/).
CONFIG_IMG_MANAGER=y
CONFIG_STREAM_FLASH=y
CONFIG_FLASH_MAP=y
CONFIG_NORDIC_QSPI_NOR=y
CONFIG_NORDIC_QSPI_NOR_FLASH_LAYOUT_PAGE_SIZE=4096
CONFIG_IMG_ERASE_PROGRESSIVELY=y
```

## boards/nrf52840dk_nrf52840.overlay
```dts
/*
 * Copyright (c) 2025 Nordic Semiconductor ASA
 *
 * SPDX-License-Identifier: LicenseRef-Nordic-5-Clause
 */

#include <nrf52840_partitions.dtsi>

/*
 * Chapter 9 addition: the FOTA flash layout. The course
 * layout's slot 0 spans almost the whole internal flash,
 * which leaves a bootloader nowhere to live; this second
 * include (the layout Nordic ships for FOTA on this board)
 * re-carves the map: boot partition 64 KB at the base,
 * slot 0 = 916 KB internal, slot 1 = 916 KB in the DK's
 * external QSPI flash. MCUboot gets the same layout through
 * sysbuild/mcuboot/'s own overlay — both images must agree
 * on the map, always.
 */
#include <ext_flash/nrf52840dk_partitions.dtsi>

/ {
	chosen {
		ncs,zigbee-timer = &timer2;
		/* Chapter 9: the cable-DFU channel. The mcumgr SMP
		 * server (prj.conf) shares the console UART — the
		 * standard smp_svr arrangement: logs and DFU on the
		 * port you already have open.
		 */
		zephyr,uart-mcumgr = &uart0;
	};
};

&timer2 {
	status = "okay";
};

/*
 * Chapter 7, Step 2 addition: the LD2410's UART.
 *
 * uart1 (RX P1.01, TX P1.02) ships disabled in the SoC; enabling
 * it is this block's whole job — the same overlay Chapter 4 used.
 * The baud rate is NOT set here: the module's 256,000 baud is
 * absent from Zephyr's devicetree baud table for this chip, so
 * the driver sets the UARTE divider register directly (the full
 * story is Chapter 4's fix F3; ld2410.c owns the quirk).
 */
&uart1 {
	status = "okay";
};
```

## include/zb_occupancy_sensor.h
```c
/*
 * Chapter 8, Step 2 — the Occupancy Sensor device declaration,
 * actuation edition.
 *
 * Chapter 7's endpoint, Chapter 8 Step 1's reporting context —
 * and one new line in the cluster list: an On/Off CLIENT cluster
 * (0x0006, client role, no attributes — a client holds nothing;
 * it *sends* the cluster's commands).
 *
 * The asymmetry is the Zigbee model in miniature. Occupancy
 * Sensing sits here as a SERVER: we hold the truth, others read
 * and subscribe. On/Off sits here as a CLIENT: the bulb holds
 * that truth; we send it commands (On, Off) — addressed, in this
 * design, to "whoever the binding table says", which is what
 * makes the coordinator's `zdo bind` the wiring step of the lab.
 *
 * The device remains, in the descriptor's eyes, an Occupancy
 * Sensor (0x0107): the client cluster appears in the simple
 * descriptor's OUT list (the flat cluster array below lists
 * server IDs first, then client IDs — the layout ZBOSS's own
 * device headers use).
 */

#ifndef ZB_OCCUPANCY_SENSOR_H
#define ZB_OCCUPANCY_SENSOR_H 1

/**
 *  @defgroup ZB_DEFINE_DEVICE_OCCUPANCY_SENSOR Occupancy Sensor
 *  @{
 *  @details
 *      - @ref ZB_ZCL_BASIC \n
 *      - @ref ZB_ZCL_IDENTIFY \n
 *      - @ref ZB_ZCL_OCCUPANCY_SENSING \n
 *      - @ref ZB_ZCL_ON_OFF (client)
 */

/** Occupancy Sensor Device ID (HA profile, ZCL device table) */
#define ZB_OCCUPANCY_SENSOR_DEVICE_ID 0x0107

/** Occupancy sensor device version */
#define ZB_DEVICE_VER_OCCUPANCY_SENSOR 0

/** @cond internals_doc */

/** Occupancy sensor IN (server) clusters number */
#define ZB_OCCUPANCY_SENSOR_IN_CLUSTER_NUM 3

/** Occupancy sensor OUT (client) clusters number */
#define ZB_OCCUPANCY_SENSOR_OUT_CLUSTER_NUM 1

#define ZB_OCCUPANCY_SENSOR_CLUSTER_NUM \
	(ZB_OCCUPANCY_SENSOR_IN_CLUSTER_NUM + ZB_OCCUPANCY_SENSOR_OUT_CLUSTER_NUM)

/** Number of attributes for reporting on Occupancy sensor device.
 * One: the Occupancy attribute is the cluster's only reportable
 * attribute (ZB_ZCL_OCCUPANCY_SENSING_REPORT_ATTR_COUNT).
 */
#define ZB_OCCUPANCY_SENSOR_REPORT_ATTR_COUNT \
	ZB_ZCL_OCCUPANCY_SENSING_REPORT_ATTR_COUNT

/** @endcond */ /* internals_doc */

/**
 * @brief Declare cluster list for Occupancy sensor device
 * @param cluster_list_name - cluster list variable name
 * @param basic_attr_list - attribute list for Basic cluster
 * @param identify_attr_list - attribute list for Identify cluster
 * @param occupancy_attr_list - attribute list for Occupancy Sensing cluster
 *
 * The On/Off client needs no attribute list parameter: a client
 * cluster instance is declared with 0 attributes and a NULL list
 * (the shape ZB_HA_DECLARE_ON_OFF_SWITCH_CLUSTER_LIST uses).
 */
#define ZB_DECLARE_OCCUPANCY_SENSOR_CLUSTER_LIST(			      \
		cluster_list_name,					      \
		basic_attr_list,					      \
		identify_attr_list,					      \
		occupancy_attr_list)					      \
zb_zcl_cluster_desc_t cluster_list_name[] =				      \
{									      \
	ZB_ZCL_CLUSTER_DESC(						      \
		ZB_ZCL_CLUSTER_ID_BASIC,				      \
		ZB_ZCL_ARRAY_SIZE(basic_attr_list, zb_zcl_attr_t),	      \
		(basic_attr_list),					      \
		ZB_ZCL_CLUSTER_SERVER_ROLE,				      \
		ZB_ZCL_MANUF_CODE_INVALID				      \
	),								      \
	ZB_ZCL_CLUSTER_DESC(						      \
		ZB_ZCL_CLUSTER_ID_IDENTIFY,				      \
		ZB_ZCL_ARRAY_SIZE(identify_attr_list, zb_zcl_attr_t),	      \
		(identify_attr_list),					      \
		ZB_ZCL_CLUSTER_SERVER_ROLE,				      \
		ZB_ZCL_MANUF_CODE_INVALID				      \
	),								      \
	ZB_ZCL_CLUSTER_DESC(						      \
		ZB_ZCL_CLUSTER_ID_OCCUPANCY_SENSING,			      \
		ZB_ZCL_ARRAY_SIZE(occupancy_attr_list, zb_zcl_attr_t),	      \
		(occupancy_attr_list),					      \
		ZB_ZCL_CLUSTER_SERVER_ROLE,				      \
		ZB_ZCL_MANUF_CODE_INVALID				      \
	),								      \
	ZB_ZCL_CLUSTER_DESC(						      \
		ZB_ZCL_CLUSTER_ID_ON_OFF,				      \
		0,							      \
		NULL,							      \
		ZB_ZCL_CLUSTER_CLIENT_ROLE,				      \
		ZB_ZCL_MANUF_CODE_INVALID				      \
	)								      \
}

/** @cond internals_doc */

/**
 * @brief Declare simple descriptor for Occupancy sensor device
 * @param ep_name - endpoint variable name
 * @param ep_id - endpoint ID
 * @param in_clust_num - number of supported input clusters
 * @param out_clust_num - number of supported output clusters
 */
#define ZB_ZCL_DECLARE_OCCUPANCY_SENSOR_SIMPLE_DESC(ep_name, ep_id, in_clust_num, out_clust_num) \
	ZB_DECLARE_SIMPLE_DESC(in_clust_num, out_clust_num);				       \
	ZB_AF_SIMPLE_DESC_TYPE(in_clust_num, out_clust_num) simple_desc_##ep_name =	       \
	{										       \
		ep_id,									       \
		ZB_AF_HA_PROFILE_ID,							       \
		ZB_OCCUPANCY_SENSOR_DEVICE_ID,						       \
		ZB_DEVICE_VER_OCCUPANCY_SENSOR,						       \
		0,									       \
		in_clust_num,								       \
		out_clust_num,								       \
		{									       \
			ZB_ZCL_CLUSTER_ID_BASIC,					       \
			ZB_ZCL_CLUSTER_ID_IDENTIFY,					       \
			ZB_ZCL_CLUSTER_ID_OCCUPANCY_SENSING,				       \
			ZB_ZCL_CLUSTER_ID_ON_OFF					       \
		}									       \
	}

/** @endcond */

/**
 * @brief Declare endpoint for Occupancy sensor device
 * @param ep_name - endpoint variable name
 * @param ep_id - endpoint ID
 * @param cluster_list - endpoint cluster list
 */
#define ZB_DECLARE_OCCUPANCY_SENSOR_EP(ep_name, ep_id, cluster_list)			      \
	ZB_ZCL_DECLARE_OCCUPANCY_SENSOR_SIMPLE_DESC(ep_name, ep_id,			      \
		ZB_OCCUPANCY_SENSOR_IN_CLUSTER_NUM, ZB_OCCUPANCY_SENSOR_OUT_CLUSTER_NUM);     \
	ZBOSS_DEVICE_DECLARE_REPORTING_CTX(reporting_info## ep_name,			      \
		ZB_OCCUPANCY_SENSOR_REPORT_ATTR_COUNT);				      \
	ZB_AF_DECLARE_ENDPOINT_DESC(ep_name, ep_id, ZB_AF_HA_PROFILE_ID, 0, NULL,	      \
		ZB_ZCL_ARRAY_SIZE(cluster_list, zb_zcl_cluster_desc_t), cluster_list,	      \
			(zb_af_simple_desc_1_1_t *)&simple_desc_##ep_name,		      \
			ZB_OCCUPANCY_SENSOR_REPORT_ATTR_COUNT,				      \
				reporting_info## ep_name,				      \
			0, NULL) /* No CVC ctx */

/*! @} */

#endif /* ZB_OCCUPANCY_SENSOR_H */
```

## src/ld2410.c
```c
/*
 * ld2410.c — the LD2410 driver, refactored in Chapter 6 of
 * Embedded DevOps, Engineered.
 *
 * What changed and what did not: the frame parser STATE MACHINE
 * moved out — it is now ld2410_parser.c, a pure module with no
 * Zephyr in it, unit-tested on a host (app/tests/ld2410_parser).
 * Everything else is Course 1's driver, untouched in behaviour:
 *
 *   UART IRQ          drains the hardware FIFO into a ring buffer
 *   parser thread     wakes on a semaphore, drains the ring, feeds
 *                     the bytes to the parser module, and for every
 *                     VALID frame the module decodes:
 *                       1. stamps it with k_uptime_get()
 *                       2. stores it as the latest snapshot
 *                       3. invokes the application callback
 *   application       never sees a byte. It sees readings.
 *
 * The public contract in ld2410.h is unchanged — Chapter 7's
 * endpoint and the shell consume this driver exactly as before.
 * A refactor that changes the interface is not a refactor; it is
 * a rewrite wearing a costume.
 */

#include "ld2410.h"
#include "ld2410_parser.h"

#include <zephyr/kernel.h>
#include <zephyr/devicetree.h>
#include <zephyr/drivers/uart.h>
#include <zephyr/sys/ring_buffer.h>
#include <zephyr/logging/log.h>
#include <hal/nrf_uarte.h>

#include <errno.h>
#include <string.h>

LOG_MODULE_REGISTER(ld2410, LOG_LEVEL_INF);

/* ------------------------------------------------------------------ */
/* Receive path.                                                       */
/* ------------------------------------------------------------------ */

#define LD2410_RING_SIZE    1024 /* power of two (byte ring rule) */
#define LD2410_THREAD_STACK 2048
#define LD2410_THREAD_PRIO  7 /* same tier as the app's helpers */

RING_BUF_DECLARE(ld2410_ring, LD2410_RING_SIZE);
static K_SEM_DEFINE(ld2410_sem, 0, 1);

/* Bytes lost to a full ring, counted in the ISR — the one piece of
 * driver state interrupt context may touch, and atomic precisely
 * because the parser thread folds it into the published stats.
 */
static atomic_t ld2410_isr_dropped;

static const struct device *ld2410_uart;
static ld2410_callback_t ld2410_cb;
static void *ld2410_cb_user;
static bool ld2410_started;

/* The parser module instance. Its counters (frames_ok, resyncs,
 * eng_frames) are the published stats' source; rx_dropped stays
 * the driver's own, folded in below.
 */
static struct ld2410_parser ld2410_parser;

static struct ld2410_stats ld2410_stats_pub; /* mutex-guarded copy  */
static struct ld2410_reading ld2410_latest_snap;
static bool ld2410_have_reading;
static K_MUTEX_DEFINE(ld2410_lock);

static void ld2410_uart_isr(const struct device *dev, void *user_data)
{
	ARG_UNUSED(user_data);

	uint8_t chunk[32];

	if (!uart_irq_update(dev)) {
		return;
	}

	while (uart_irq_rx_ready(dev)) {
		int n = uart_fifo_read(dev, chunk, sizeof(chunk));

		if (n <= 0) {
			break;
		}

		uint32_t stored = ring_buf_put(&ld2410_ring, chunk, (uint32_t)n);

		if (stored < (uint32_t)n) {
			/* The one counter written from ISR context:
			 * atomic, and mirrored into the published
			 * stats by the parser thread.
			 */
			atomic_add(&ld2410_isr_dropped, n - (int)stored);
		}

		k_sem_give(&ld2410_sem);
	}
}

/* Mirror the parser module's counters (+ the ISR drop count) into
 * the mutex-guarded published copy the shell and the app read.
 * Parser-thread context only.
 */
static void stats_sync(void)
{
	long dropped = atomic_set(&ld2410_isr_dropped, 0);

	k_mutex_lock(&ld2410_lock, K_FOREVER);
	ld2410_stats_pub.frames_ok = ld2410_parser.frames_ok;
	ld2410_stats_pub.resyncs = ld2410_parser.resyncs;
	ld2410_stats_pub.eng_frames = ld2410_parser.eng_frames;
	ld2410_stats_pub.rx_dropped += (uint32_t)dropped;
	k_mutex_unlock(&ld2410_lock);
}

static void publish_reading(const struct ld2410_report *rep)
{
	struct ld2410_reading r = {
		.target = (enum ld2410_target)rep->target,
		.move_distance_cm = rep->move_distance_cm,
		.move_energy = rep->move_energy,
		.still_distance_cm = rep->still_distance_cm,
		.still_energy = rep->still_energy,
		.detect_distance_cm = rep->detect_distance_cm,
		.timestamp_ms = k_uptime_get(),
	};

	k_mutex_lock(&ld2410_lock, K_FOREVER);
	ld2410_latest_snap = r;
	ld2410_have_reading = true;
	k_mutex_unlock(&ld2410_lock);

	LOG_DBG("frame: target %d, move %u cm (e%u), still %u cm (e%u)", r.target,
		r.move_distance_cm, r.move_energy, r.still_distance_cm, r.still_energy);

	if (ld2410_cb != NULL) {
		ld2410_cb(&r, ld2410_cb_user);
	}
}

/* ------------------------------------------------------------------ */
/* The parser thread — the driver's engine room.                       */
/* ------------------------------------------------------------------ */

static void ld2410_thread(void *p1, void *p2, void *p3)
{
	ARG_UNUSED(p1);
	ARG_UNUSED(p2);
	ARG_UNUSED(p3);

	uint8_t bytes[64];

	while (1) {
		k_sem_take(&ld2410_sem, K_FOREVER);

		uint32_t n;

		while ((n = ring_buf_get(&ld2410_ring, bytes, sizeof(bytes))) > 0) {
			for (uint32_t i = 0; i < n; i++) {
				struct ld2410_report rep;

				if (ld2410_parser_feed(&ld2410_parser, bytes[i], &rep)) {
					publish_reading(&rep);
				}
			}
		}

		stats_sync();
	}
}

K_THREAD_DEFINE(ld2410_thread_id, LD2410_THREAD_STACK, ld2410_thread, NULL, NULL, NULL,
		LD2410_THREAD_PRIO, 0, 0);

/* ------------------------------------------------------------------ */
/* The public interface (the contract is in ld2410.h).                 */
/* ------------------------------------------------------------------ */

int ld2410_start(const struct device *uart, ld2410_callback_t cb, void *user_data)
{
	if (ld2410_started) {
		return -EALREADY;
	}
	if (!device_is_ready(uart)) {
		return -ENODEV;
	}

	ld2410_uart = uart;
	ld2410_cb = cb;
	ld2410_cb_user = user_data;

	ld2410_parser_init(&ld2410_parser);

	/*
	 * The module's 256,000 baud exists in NEITHER of Zephyr's
	 * baud tables for this chip — the devicetree binding
	 * rejects it and the UARTE driver's lookup returns
	 * -EINVAL (Step 1 tells the whole story). So the driver
	 * writes the divider register directly, from the
	 * nRF52840 datasheet formula:
	 *
	 *     BAUDRATE = baud * 2^32 / 16,000,000  (peripheral clock)
	 *
	 * giving an actual rate of 255,999.997. The `uart` device
	 * handed in is uart1 (see the application); its register
	 * block comes from that same devicetree node. Owning this
	 * quirk HERE — one place, commented — is what makes it a
	 * driver detail instead of an application bug.
	 */
	nrf_uarte_baudrate_set((NRF_UARTE_Type *)DT_REG_ADDR(DT_NODELABEL(uart1)),
			       (nrf_uarte_baudrate_t)((256000ULL << 32) / 16000000ULL));

	uart_irq_callback_user_data_set(ld2410_uart, ld2410_uart_isr, NULL);
	uart_irq_rx_enable(ld2410_uart);

	ld2410_started = true;

	LOG_INF("LD2410 driver started (basic reporting mode expected)");

	return 0;
}

bool ld2410_latest(struct ld2410_reading *out)
{
	k_mutex_lock(&ld2410_lock, K_FOREVER);
	bool have = ld2410_have_reading;

	if (have && out != NULL) {
		*out = ld2410_latest_snap;
	}
	k_mutex_unlock(&ld2410_lock);

	return have;
}

void ld2410_stats(struct ld2410_stats *out)
{
	k_mutex_lock(&ld2410_lock, K_FOREVER);
	if (out != NULL) {
		*out = ld2410_stats_pub;
	}
	k_mutex_unlock(&ld2410_lock);
}

uint16_t ld2410_headline_distance_cm(const struct ld2410_reading *r)
{
	if (r == NULL) {
		return 0;
	}

	/* The rule itself lives in the parser module now (it is
	 * report logic, not driver logic); convert and delegate.
	 */
	struct ld2410_report rep = {
		.target = (enum ld2410_parser_target)r->target,
		.move_distance_cm = r->move_distance_cm,
		.move_energy = r->move_energy,
		.still_distance_cm = r->still_distance_cm,
		.still_energy = r->still_energy,
		.detect_distance_cm = r->detect_distance_cm,
	};

	return ld2410_report_headline_cm(&rep);
}
```

## src/ld2410.h
```c
/*
 * ld2410.h — a small driver for the HLK-LD2410 mmWave sensor.
 *
 * THE CONTRACT (everything application code is allowed to know):
 *
 *   - Call ld2410_start() once with the sensor's UART device.
 *     From then on, the driver runs itself: its own interrupt,
 *     its own parser thread, its own counters.
 *   - Every VALID frame invokes your callback — or, ignore the
 *     callback (pass NULL) and poll ld2410_latest() instead.
 *   - The callback runs in the DRIVER'S parser thread context.
 *     Keep it short: copy the reading, submit a work item
 *     (Chapter 2), get out. The example app does exactly that.
 *   - A reading is a snapshot struct, copied by value. No
 *     pointers into driver internals ever escape.
 *   - ld2410_stats() exposes the honesty counters: frames
 *     parsed, resyncs, dropped ring bytes. If the wiring is
 *     bad, these numbers say so before your users do.
 *
 * What the driver hides, on purpose: bytes, frames, the ring
 * buffer, the state machine, the UART API. Chapter 7's Zigbee
 * endpoint will consume THIS interface — it will never see a
 * byte, and that is the point of a driver.
 */

#ifndef LD2410_H_
#define LD2410_H_

#include <zephyr/device.h>

#include <stdbool.h>
#include <stdint.h>

#ifdef __cplusplus
extern "C" {
#endif

/* Target state, exactly as the module reports it. */
enum ld2410_target {
	LD2410_TARGET_NONE = 0,       /* nobody detected            */
	LD2410_TARGET_MOVING = 1,     /* a moving target only       */
	LD2410_TARGET_STATIONARY = 2, /* a still target only        */
	LD2410_TARGET_BOTH = 3,       /* moving AND still targets   */
};

/* One parsed presence report. Distances in centimetres,
 * energies 0..100 as the module scales them.
 */
struct ld2410_reading {
	enum ld2410_target target;
	uint16_t move_distance_cm;
	uint8_t move_energy;
	uint16_t still_distance_cm;
	uint8_t still_energy;
	uint16_t detect_distance_cm; /* the module's max-of-two */
	int64_t timestamp_ms;        /* k_uptime_get() at parse time */
};

struct ld2410_stats {
	uint32_t frames_ok;  /* valid basic reports parsed */
	uint32_t resyncs;    /* sequences abandoned        */
	uint32_t eng_frames; /* engineering-mode frames (counted, not decoded) */
	uint32_t rx_dropped; /* bytes lost to a full ring buffer */
};

/*
 * Called from the driver's parser thread for every valid frame.
 * `reading` is valid only for the duration of the call — copy
 * what you need (it is a small struct; copy the whole thing).
 */
typedef void (*ld2410_callback_t)(const struct ld2410_reading *reading, void *user_data);

/*
 * Start the driver on an already-enabled UART device (see the
 * step's app.overlay — the device must be uart1). The driver
 * sets the port to the module's documented 256,000 baud itself:
 * that rate is missing from Zephyr's baud tables for this chip,
 * so ld2410.c writes the UARTE divider register from the
 * datasheet formula. cb may be NULL if you only poll
 * ld2410_latest(). Returns 0, or a negative errno if the UART
 * is not ready. Calling twice is an error (-EALREADY): one
 * sensor, one driver instance — this module is deliberately a
 * singleton, like the hardware it serves.
 */
int ld2410_start(const struct device *uart, ld2410_callback_t cb, void *user_data);

/* Copy out the most recent valid reading. Returns false (and
 * touches nothing) if no valid frame has arrived yet.
 */
bool ld2410_latest(struct ld2410_reading *out);

/* Copy out the counters. Always succeeds. */
void ld2410_stats(struct ld2410_stats *out);

/*
 * The one question the product asks most: how far away is the
 * person? Stationary wins when present (a seated person is the
 * occupancy case), else the moving target, else 0 for nobody.
 * Chapter 7 turns this into an attribute; here it is a function.
 */
uint16_t ld2410_headline_distance_cm(const struct ld2410_reading *r);

#ifdef __cplusplus
}
#endif

#endif /* LD2410_H_ */
```

## src/ld2410_parser.c
```c
/*
 * ld2410_parser.c — Course 1's parser state machine, extracted
 * unchanged in behaviour by Chapter 6 of Embedded DevOps,
 * Engineered. The only deliberate differences from the driver
 * version: parser state lives in the caller's struct (no statics),
 * decoded fields leave in a struct instead of a callback, and the
 * two bytes of a little-endian field are assembled by hand so this
 * file needs nothing but the C standard library.
 */

#include "ld2410_parser.h"

#include <string.h>

enum parser_state {
	PS_HUNT,
	PS_LEN,
	PS_PAYLOAD,
	PS_FOOTER
};

static const uint8_t header_seq[4] = {0xF4, 0xF3, 0xF2, 0xF1};
static const uint8_t footer_seq[4] = {0xF8, 0xF7, 0xF6, 0xF5};

static uint16_t get_le16(const uint8_t *b)
{
	return (uint16_t)((uint16_t)b[0] | ((uint16_t)b[1] << 8));
}

void ld2410_parser_init(struct ld2410_parser *p)
{
	memset(p, 0, sizeof(*p));
	p->state = PS_HUNT;
}

static void parser_reset(struct ld2410_parser *p)
{
	p->state = PS_HUNT;
	p->match = 0;
	p->len = 0;
	p->len_bytes = 0;
	p->payload_pos = 0;
}

static void parser_abort(struct ld2410_parser *p)
{
	p->resyncs++;
	parser_reset(p);
}

/*
 * A complete payload sits in p->payload. Validate and decode it.
 * Returns true (and fills *out) for a valid basic report only;
 * engineering frames are counted, invalid payloads cost a resync —
 * the driver's exact accounting.
 */
static bool handle_payload(struct ld2410_parser *p, struct ld2410_report *out)
{
	if (p->payload[0] == LD2410_TYPE_ENGINEERING) {
		p->eng_frames++;
		return false;
	}

	if (p->payload[0] != LD2410_TYPE_BASIC || p->len != 13 || p->payload[1] != 0xAA ||
	    p->payload[11] != 0x55 || p->payload[12] != 0x00) {
		parser_abort(p);
		return false;
	}

	/* The protocol has no checksum, so the markers above are not
	 * enough: the target-state byte can still be anything the wire
	 * (or a fault) invents. Only 0..3 name a target (the enum
	 * below); anything else is a malformed frame. Reject it here,
	 * at the trust boundary, before the value can be published as
	 * a reading and used to index lookup tables by callers.
	 */
	if (p->payload[2] > LD2410_PARSER_TARGET_BOTH) {
		parser_abort(p);
		return false;
	}

	if (out != NULL) {
		out->target = (enum ld2410_parser_target)p->payload[2];
		out->move_distance_cm = get_le16(&p->payload[3]);
		out->move_energy = p->payload[5];
		out->still_distance_cm = get_le16(&p->payload[6]);
		out->still_energy = p->payload[8];
		out->detect_distance_cm = get_le16(&p->payload[9]);
	}
	p->frames_ok++;
	return true;
}

bool ld2410_parser_feed(struct ld2410_parser *p, uint8_t byte, struct ld2410_report *out)
{
	switch (p->state) {
	case PS_HUNT:
		if (byte == header_seq[p->match]) {
			p->match++;
			if (p->match == sizeof(header_seq)) {
				p->state = PS_LEN;
				p->match = 0;
				p->len = 0;
				p->len_bytes = 0;
			}
		} else {
			p->match = (byte == header_seq[0]) ? 1 : 0;
		}
		break;

	case PS_LEN:
		p->len |= (uint16_t)byte << (8 * p->len_bytes);
		p->len_bytes++;
		if (p->len_bytes == 2) {
			if (p->len < 3 || p->len > LD2410_MAX_PAYLOAD) {
				parser_abort(p);
			} else {
				p->state = PS_PAYLOAD;
				p->payload_pos = 0;
			}
		}
		break;

	case PS_PAYLOAD:
		p->payload[p->payload_pos++] = byte;
		if (p->payload_pos >= p->len) {
			p->state = PS_FOOTER;
			p->match = 0;
		}
		break;

	case PS_FOOTER:
		if (byte == footer_seq[p->match]) {
			p->match++;
			if (p->match == sizeof(footer_seq)) {
				bool decoded = handle_payload(p, out);

				parser_reset(p);
				return decoded;
			}
		} else {
			parser_abort(p);
			if (byte == header_seq[0]) {
				p->state = PS_HUNT;
				p->match = 1;
			}
		}
		break;
	}

	return false;
}

uint16_t ld2410_report_headline_cm(const struct ld2410_report *r)
{
	if (r == NULL) {
		return 0;
	}

	switch (r->target) {
	case LD2410_PARSER_TARGET_STATIONARY:
	case LD2410_PARSER_TARGET_BOTH:
		return r->still_distance_cm;
	case LD2410_PARSER_TARGET_MOVING:
		return r->move_distance_cm;
	default:
		return 0;
	}
}
```

## src/ld2410_parser.h
```c
/*
 * ld2410_parser.h — the LD2410 frame parser as a pure module.
 *
 * Chapter 6 of Embedded DevOps, Engineered extracted this state
 * machine out of the UART-bound driver (Course 1's ld2410.c) so it
 * can be unit-tested on a host: no Zephyr headers, no threads, no
 * device — bytes in, decoded reports out. The driver keeps a parser
 * instance and feeds it from its ring buffer; the tests feed it from
 * arrays. Same code, two hosts.
 *
 * Frame: F4 F3 F2 F1 | len u16 LE | payload[len] | F8 F7 F6 F5
 * Basic report payload (len 13):
 *   [0] 0x02 type · [1] 0xAA · [2] target state · [3..4] move dist
 *   LE cm · [5] move energy · [6..7] still dist LE cm · [8] still
 *   energy · [9..10] detection dist LE cm · [11] 0x55 · [12] 0x00
 * No checksum exists in this protocol; markers + length + footer
 * are the validation, and resyncs are counted, never hidden.
 */

#ifndef LD2410_PARSER_H_
#define LD2410_PARSER_H_

#include <stdbool.h>
#include <stdint.h>

#ifdef __cplusplus
extern "C" {
#endif

#define LD2410_TYPE_BASIC       0x02
#define LD2410_TYPE_ENGINEERING 0x01
#define LD2410_MAX_PAYLOAD      64

/* Target state, exactly as the module reports it. Values match
 * enum ld2410_target in ld2410.h — the driver converts by cast.
 */
enum ld2410_parser_target {
	LD2410_PARSER_TARGET_NONE = 0,
	LD2410_PARSER_TARGET_MOVING = 1,
	LD2410_PARSER_TARGET_STATIONARY = 2,
	LD2410_PARSER_TARGET_BOTH = 3,
};

/* One decoded basic report. No timestamp: when a frame arrived is
 * the caller's business (the driver stamps k_uptime_get()); what
 * the frame SAID is the parser's.
 */
struct ld2410_report {
	enum ld2410_parser_target target;
	uint16_t move_distance_cm;
	uint8_t move_energy;
	uint16_t still_distance_cm;
	uint8_t still_energy;
	uint16_t detect_distance_cm;
};

/* Parser instance. Stack-allocatable, no hidden globals: two
 * parsers can run side by side (the tests do exactly that).
 */
struct ld2410_parser {
	uint8_t state;     /* enum parser_state (private) */
	uint8_t match;     /* header/footer match progress  */
	uint16_t len;      /* declared payload length       */
	uint8_t len_bytes; /* length bytes consumed so far  */
	uint8_t payload[LD2410_MAX_PAYLOAD];
	uint16_t payload_pos;

	/* The honesty counters, same meanings as the driver's:
	 * valid basic reports, abandoned sequences, engineering
	 * frames seen (counted, not decoded).
	 */
	uint32_t frames_ok;
	uint32_t resyncs;
	uint32_t eng_frames;
};

void ld2410_parser_init(struct ld2410_parser *p);

/*
 * Feed one byte. Returns true exactly when this byte completed a
 * VALID basic report, which is then stored in *out (out may be
 * NULL if only the counters matter). Engineering frames, resyncs
 * and partial frames all return false; the counters say which.
 */
bool ld2410_parser_feed(struct ld2410_parser *p, uint8_t byte, struct ld2410_report *out);

/*
 * The product's favourite question: how far away is the person?
 * Stationary wins when present (a seated person is the occupancy
 * case), else the moving target, else 0 for nobody.
 */
uint16_t ld2410_report_headline_cm(const struct ld2410_report *r);

#ifdef __cplusplus
}
#endif

#endif /* LD2410_PARSER_H_ */
```
